## conf/layer.conf
```bitbake
# We have a conf and classes directory, add to BBPATH
BBPATH .= ":${LAYERDIR}"

# We have recipes-* directories, add to BBFILES
BBFILES += "${LAYERDIR}/recipes-*/*/*.bb \
            ${LAYERDIR}/recipes-*/*/*.bbappend"

BBFILE_COLLECTIONS += "meta-tn-vizionsdk"
BBFILE_PATTERN_meta-tn-vizionsdk = "^${LAYERDIR}/"

LAYERDEPENDS_meta-tn-vizionsdk = "core"
LAYERSERIES_COMPAT_meta-tn-vizionsdk = "kirkstone"
```
